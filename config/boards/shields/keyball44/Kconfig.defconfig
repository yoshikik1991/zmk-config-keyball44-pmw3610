## config/boards/shields/keyball44/Kconfig.defconfig
```kconfig
if SHIELD_KEYBALL44_RIGHT

config ZMK_KEYBOARD_NAME
    default "Keyball44"

config ZMK_SPLIT_BLE_ROLE_CENTRAL
    default y

endif

if SHIELD_KEYBALL44_LEFT || SHIELD_KEYBALL44_RIGHT

config ZMK_SPLIT
    default y

endif
```
